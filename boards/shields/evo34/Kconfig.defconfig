## boards/shields/evo34/Kconfig.defconfig
```kconfig
if SHIELD_EVO34_LEFT

config ZMK_KEYBOARD_NAME
    default "evo34"

config ZMK_SPLIT_ROLE_CENTRAL
    default y

endif # SHIELD_EVO34_LEFT

if SHIELD_EVO34_LEFT || SHIELD_EVO34_RIGHT

config ZMK_SPLIT
    default y

endif # SHIELD_EVO34_LEFT || SHIELD_EVO34_RIGHT
```

## boards/shields/evo34/Kconfig.shield
```kconfig
config SHIELD_EVO34_LEFT
    def_bool $(shields_list_contains,evo34_left)

config SHIELD_EVO34_RIGHT
    def_bool $(shields_list_contains,evo34_right)
```

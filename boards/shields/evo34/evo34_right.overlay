// This file was generated from a template. Edit it to match your keyboard.
// See https://zmk.dev/docs/development/hardware-integration/new-shield for more
// instructions.

#include "evo34.dtsi"

&default_transform {
    // Set this to the number of columns on the left side.
    col-offset = <5>;
};

&kscan {
    // Replace these comments with the GPIO pins in the matrix for the right side.
    // See https://zmk.dev/docs/development/hardware-integration/new-shield#shield-overlays
    col-gpios
        = <&nice_nano_v2 15 GPIO_ACTIVE_HIGH>
        , <&nice_nano_v2 18 GPIO_ACTIVE_HIGH>
        , <&nice_nano_v2 19 GPIO_ACTIVE_HIGH>
        , <&nice_nano_v2 20 GPIO_ACTIVE_HIGH>
        , <&nice_nano_v2 21 GPIO_ACTIVE_HIGH>
        ;
};
